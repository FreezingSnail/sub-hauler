#pragma once

// Raw single-slot fresh-voyage checkpoints in the Arduboy FX save region.
//
// Contract summary:
//   * a 4 KiB save partition generated by `savesection 4096`, one erase block;
//   * the payload starts at offset 0: 16 scalar bytes followed by the explored
//     chart (world::CHART_BYTES, currently 256), 272 meaningful bytes;
//   * each save erases once and programs exactly two 256 B pages, padding the
//     unused bytes after the payload with 0xFF. Identical saves are not skipped;
//   * the first byte is the berth id, so an erased slot (0xFF) is blank and any
//     other value is a written record. Load reads every field raw, with only
//     memory-safe bounds guards; there is no magic, schema, length, CRC,
//     commit, cache or semantic validation;
//   * rescue loads only and never writes;
//   * a power interruption during erase/write may lose the previous checkpoint
//     or leave a torn record, which still loads raw.
//
// This header is pure C++ so the host tests exercise the exact code the device
// compiles; Storage is the only place that touches the SPI cart.

#include <stdint.h>

#include "campaign.hpp"
#include "game.hpp"
#include "pilot.hpp"
#include "world.hpp"
#include "chart.hpp"
#include "generated/exploration.hpp"

namespace voyage_save {

using game::State;

// ---------------------------------------------------------------------------
// Layout
// ---------------------------------------------------------------------------

constexpr uint16_t kSaveBytes = 4096;
constexpr uint16_t kBlockBytes = 4096;
constexpr uint16_t kPagesPerBlock = 16;
constexpr uint16_t kPageBytes = 256;
constexpr uint16_t kWritePages = 2;
constexpr uint16_t kWriteBytes = kWritePages * kPageBytes;

constexpr uint16_t kScalarBytes = 16;
constexpr uint16_t kChartBytes = world::CHART_BYTES;
constexpr uint16_t kPayloadBytes = kScalarBytes + kChartBytes;

static_assert(kSaveBytes == kBlockBytes, "save partition is one erase block");
static_assert(kPageBytes * kWritePages <= kBlockBytes, "two pages fit the erase block");
static_assert(kPayloadBytes <= kWriteBytes, "payload fits the two programmed pages");
static_assert(kScalarBytes == 16, "scalar payload is frozen at 16 bytes");

enum LoadResult : uint8_t {
    kLoaded,
    kNoSave,
};

// ---------------------------------------------------------------------------
// Scalar payload (16 B, fixed field order)
// ---------------------------------------------------------------------------

// Transient only: 16 bytes, never persisted as a C++ struct.
struct Scalar {
    uint8_t bytes[kScalarBytes];
};

enum ScalarOffset : uint8_t {
    kFieldBerth = 0,
    kFieldTools = 1,
    kFieldPickups = 2,
    kFieldOpenGates = 3,
    kFieldSeenGates = 5,
    kFieldCampaign = 7,
    kFieldSurveys = 8,
    kFieldJobKind = 9,
    kFieldJobMission = 10,
    kFieldJobFrom = 11,
    kFieldJobTo = 12,
    kFieldJobCrates = 13,
    kFieldEnding = 14,
    kFieldPendingStory = 15,
};

static_assert(kFieldPendingStory + 1 == kScalarBytes, "scalar field table covers the payload");

// Pending scene ids are 0 (none) through story_view::kSceneMax (17). This
// storage layer must not include the presentation header, so app.hpp pins the
// coupling.
constexpr uint8_t kPendingStoryNone = 0;
constexpr uint8_t kPendingStoryMax = 17;

inline uint8_t scalarU8(const Scalar &scalar, uint8_t offset) {
    return scalar.bytes[offset];
}

inline uint16_t scalarU16(const Scalar &scalar, uint8_t offset) {
    return static_cast<uint16_t>(scalar.bytes[offset] | (static_cast<uint16_t>(scalar.bytes[offset + 1]) << 8));
}

inline uint8_t toolsMask() {
    return static_cast<uint8_t>(exploration_data::CUTTER | exploration_data::SEAL | exploration_data::THRUSTER | exploration_data::LENS);
}

inline uint8_t pickupsMask() {
    return static_cast<uint8_t>((1u << exploration_data::PICKUP_COUNT) - 1u);
}

inline uint16_t gatesMask() {
    return static_cast<uint16_t>((1u << exploration_data::GATE_COUNT) - 1u);
}

// Serialize one scalar byte directly from live state.
inline uint8_t statePayloadByte(const State &state, uint16_t index) {
    switch (index) {
    case kFieldBerth:
        return static_cast<uint8_t>(state.docked);
    case kFieldTools:
        return state.tools;
    case kFieldPickups:
        return state.pickups;
    case kFieldOpenGates:
        return static_cast<uint8_t>(state.openGates);
    case kFieldOpenGates + 1:
        return static_cast<uint8_t>(state.openGates >> 8);
    case kFieldSeenGates:
        return static_cast<uint8_t>(state.seenGates);
    case kFieldSeenGates + 1:
        return static_cast<uint8_t>(state.seenGates >> 8);
    case kFieldCampaign:
        return state.campaign;
    case kFieldSurveys:
        return state.surveys;
    case kFieldJobKind:
        return state.activeJob.kind;
    case kFieldJobMission:
        return state.activeJob.mission;
    case kFieldJobFrom:
        return state.activeJob.from;
    case kFieldJobTo:
        return state.activeJob.to;
    case kFieldJobCrates:
        return state.activeJob.crates;
    case kFieldEnding:
        return state.ending;
    case kFieldPendingStory:
        return state.pendingStory;
    default:
        return 0xFF;
    }
}

inline uint8_t payloadByteFromState(const State &state, const chart::State &chart, uint16_t index) {
    if (index < kScalarBytes)
        return statePayloadByte(state, index);
    const uint16_t chartIndex = static_cast<uint16_t>(index - kScalarBytes);
    return chartIndex < kChartBytes ? chart.explored[chartIndex] : 0xFF;
}

template <typename Storage> inline void readScalar(Storage &storage, uint16_t payload, Scalar &scalar) {
    for (uint8_t i = 0; i < kScalarBytes; ++i)
        scalar.bytes[i] = storage.read(static_cast<uint16_t>(payload + i));
}

// Two 256 B page programs. Bytes after the 272 B payload are 0xFF padding.
template <typename Storage> inline void writePages(Storage &storage, const State &state, const chart::State &chart) {
    storage.pageBegin(0);
    for (uint16_t i = 0; i < kPageBytes; ++i)
        storage.pageByte(payloadByteFromState(state, chart, i));
    storage.pageEnd();

    storage.pageBegin(1);
    for (uint16_t i = kPageBytes; i < kWriteBytes; ++i)
        storage.pageByte(payloadByteFromState(state, chart, i));
    storage.pageEnd();
}

// The first byte is the berth id, so an erased slot reads 0xFF. There is no
// further validation: a written slot is loaded as-is.
template <typename Storage> inline bool hasSave(Storage &storage) {
    return storage.read(0) != 0xFF;
}

// ---------------------------------------------------------------------------
// Load
// ---------------------------------------------------------------------------

// Put the boat on the generated dock anchor and snap the follow camera.
inline bool positionAtBerth(State &state, uint8_t berthId) {
    world::Berth berth;
    if (!world::berthInfo(berthId, berth))
        return false;
    state.x = berth.pixel_x;
    state.y = berth.pixel_y;
    game::snapCamera(state);
    return true;
}

// Apply a raw scalar with only memory-safe guards: an unknown berth leaves the
// boat at the reset position in free flight, an out-of-range pending deck is
// dropped, and cargo is clamped to the hold. Campaign, survey and job bytes are
// otherwise loaded verbatim.
inline void applyScalar(const Scalar &scalar, State &state) {
    game::reset(state);

    const uint8_t berth = scalarU8(scalar, kFieldBerth);
    if (positionAtBerth(state, berth))
        state.docked = static_cast<int8_t>(berth);
    else
        state.docked = -1;

    state.tools = scalarU8(scalar, kFieldTools);
    state.pickups = scalarU8(scalar, kFieldPickups);
    state.openGates = scalarU16(scalar, kFieldOpenGates);
    state.seenGates = scalarU16(scalar, kFieldSeenGates);
    state.campaign = scalarU8(scalar, kFieldCampaign);
    state.surveys = scalarU8(scalar, kFieldSurveys);
    state.activeJob.kind = scalarU8(scalar, kFieldJobKind);
    state.activeJob.mission = scalarU8(scalar, kFieldJobMission);
    state.activeJob.from = scalarU8(scalar, kFieldJobFrom);
    state.activeJob.to = scalarU8(scalar, kFieldJobTo);
    state.activeJob.crates = scalarU8(scalar, kFieldJobCrates);
    state.ending = scalarU8(scalar, kFieldEnding);

    const uint8_t pending = scalarU8(scalar, kFieldPendingStory);
    state.pendingStory = pending <= kPendingStoryMax ? pending : kPendingStoryNone;

    // A checkpoint is always at a berth. Cargo is derived from the active job;
    // service restores full air and neutral trim for that load.
    game::setCargo(state, state.activeJob.kind == game::kJobKindNone ? 0 : state.activeJob.crates);
    state.ballast = static_cast<uint8_t>(game::neutralForNormalized(state.cargo));
    state.air = game::airCapacity(state);
}

// Read a written slot as-is. The first byte is only used to distinguish an
// erased slot from a written one; no header, CRC or semantic checks run.
template <typename Storage> inline LoadResult load(State &state, chart::State &chart, Storage &storage) {
    if (!hasSave(storage))
        return kNoSave;

    Scalar scalar;
    readScalar(storage, 0, scalar);
    applyScalar(scalar, state);
    for (uint16_t i = 0; i < kChartBytes; ++i)
        chart.explored[i] = storage.read(static_cast<uint16_t>(kScalarBytes + i));
    return kLoaded;
}

// ---------------------------------------------------------------------------
// Save transaction
// ---------------------------------------------------------------------------

// Transaction order:
//   1. erase the single 4 KiB block;
//   2. program page 0 (payload bytes 0..255);
//   3. program page 1 (payload bytes 256..271 and 0xFF padding).
// Success is reported after both page programs finish. There is no post-write
// read-back and no skip cache: every explicit save, including an identical
// one, erases and programs both pages.
template <typename Storage> inline void save(const State &state, const chart::State &chart, Storage &storage) {
    storage.eraseBlock(0);
    writePages(storage, state, chart);
}

// ---------------------------------------------------------------------------
// Explicit new voyage
// ---------------------------------------------------------------------------

template <typename Storage> inline void newVoyage(State &state, chart::State &chart, Storage &storage) {
    game::reset(state);
    state.docked = static_cast<int8_t>(campaign::kTidewall);
    (void)positionAtBerth(state, static_cast<uint8_t>(campaign::kTidewall));

    // A new voyage always starts with an empty chart plus the deterministic
    // spawn reveal, and that first checkpoint includes both. No legacy bytes are
    // read or imported; the single slot is erased and rewritten.
    chart::reset(chart);
    chart::revealInitial(chart, state);
    save(state, chart, storage);
}

#if defined(ARDUINO)
#include <ArduboyFX.h>

#include "fxdata.h"

// Device adapter. The sketch names only voyage_save::save/load/newVoyage; the
// pure code above stays free of Arduino headers for the host tests.
//
// Both page programs complete before the caller resumes music, so no stream
// refill can overlap a cart write.
struct FxStorage {
    static void begin() {
        FX::begin(FX_DATA_PAGE, FX_SAVE_PAGE);
    }

    uint8_t read(uint16_t offset) {
        FX::seekSave(offset);
        const uint8_t value = FX::readPendingUInt8();
        FX::readEnd();
        return value;
    }

    void eraseBlock(uint8_t block) {
        FX::eraseSaveBlock(static_cast<uint16_t>(block * kPagesPerBlock));
        FX::waitWhileBusy();
    }

    void pageBegin(uint16_t page) {
        // programSavePage is the runtime source used by seekSave and
        // eraseSaveBlock; using the compile-time FX_SAVE_PAGE here would write a
        // different page from the one seekSave reads.
        FX::writeEnable();
        FX::seekCommand(SFC_WRITE, static_cast<uint24_t>(FX::programSavePage + page) << 8);
    }

    void pageByte(uint8_t value) {
        FX::writeByte(value);
    }

    void pageEnd() {
        FX::disable();
        FX::waitWhileBusy();
    }
};
#endif

}   // namespace voyage_save
